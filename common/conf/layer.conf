## meta-steppeeagle/conf/machine/steppeeagle.conf
```bitbake
#@TYPE: Machine
#@NAME: steppeeagle

#@DESCRIPTION: Machine configuration for steppeeagle systems

PREFERRED_PROVIDER_virtual/kernel ?= "linux-yocto"

require conf/machine/include/tune-steppeeagle.inc

include conf/machine/include/amd-common-configurations.inc

# Disable GPU if RT kernel is in use
XSERVER_X86_RADEON = "xf86-video-amd \
           ${@bb.utils.contains('DISTRO_FEATURES', 'opengl', 'mesa-driver-radeon', '', d)} \
           "
XSERVER_X86_NOGPU = "${@bb.utils.contains('DISTRO_FEATURES', 'opengl', 'mesa-driver-swrast', '', d)}"
XSERVER_X86_GPU = "${@bb.utils.contains('RT_KERNEL_AMD', 'yes', "${XSERVER_X86_NOGPU}", "${XSERVER_X86_RADEON}", d)}"

XSERVER ?= "${XSERVER_X86_BASE} \
            ${XSERVER_X86_EXT} \
            ${XSERVER_X86_FBDEV} \
            ${XSERVER_X86_MODESETTING} \
            ${XSERVER_X86_GPU} \
           "

MACHINE_EXTRA_RRECOMMENDS += "radeon-firmware"
MACHINE_EXTRA_RRECOMMENDS += "amd-gpio"

# Setup a gettys on all serial ports
SERIAL_CONSOLES = "115200;ttyUSB0"

# Make sure the kernel messages go to the VGA console and to the serial ports.
KERNEL_SERIAL_CONSOLE = "console=ttyUSB0,115200n8"

APPEND += "radeon.dpm=1"

MACHINEOVERRIDES =. "amd:amdx86:radeon:"

# Metadata used by CodeBench for the ADE
ADE_CB_CPU = "general.cpu.puma"
```

## meta-v1000/conf/layer.conf
```bitbake
# We have a conf and classes directory, add to BBPATH
BBPATH .= ":${LAYERDIR}"

# We have a recipes-* directories, add to BBFILES
BBFILES += "${LAYERDIR}/recipes-*/*/*.bb \
	${LAYERDIR}/recipes-*/*/*.bbappend"

BBFILE_COLLECTIONS += "v1000"
BBFILE_PATTERN_v1000 = "^${LAYERDIR}/"
BBFILE_PRIORITY_v1000 = "14"

LAYERDEPENDS_v1000 = "amd openembedded-layer"
```

## meta-v1000/conf/machine/v1000.conf
```bitbake
#@TYPE: Machine
#@NAME: v1000

#@DESCRIPTION: Machine configuration for v1000 systems

PREFERRED_PROVIDER_virtual/kernel ?= "linux-yocto"
PREFERRED_VERSION_linux-yocto ?= "4.9%"
PREFERRED_VERSION_mesa ?= "17.3.0+git%"
PREFERRED_PROVIDER_llvm ?= "llvm6.0"

require conf/machine/include/tune-v1000.inc

include conf/machine/include/amd-common-configurations.inc
include conf/machine/include/amd-customer-configurations.inc

# GPU
XSERVER_X86_GPU = "xf86-video-amd \
           ${@bb.utils.contains('DISTRO_FEATURES', 'opengl', 'mesa-driver-radeonsi', '', d)} \
           "

XSERVER ?= "${XSERVER_X86_BASE} \
            ${XSERVER_X86_EXT} \
            ${XSERVER_X86_FBDEV} \
            ${XSERVER_X86_MODESETTING} \
            ${XSERVER_X86_GPU} \
           "

KERNEL_MODULE_AUTOLOAD += "snd-soc-acp-pcm snd-soc-acp-rt286-mach"
MACHINE_EXTRA_RRECOMMENDS += "amdgpu-firmware"
MACHINE_EXTRA_RRECOMMENDS_remove = "rtc-test smbus-test"

# Setup a getty on all serial ports
SERIAL_CONSOLES ?= "115200;ttyS4 115200;ttyS5 115200;ttyUSB0"

# Enable the kernel console on ttyS4/USB0 as well
KERNEL_SERIAL_CONSOLE ?= "console=ttyS4,115200n8 console=ttyUSB0,115200n8"

TOOLCHAIN_HOST_TASK_append_mel = " ${@bb.utils.contains('INCLUDE_VULKAN', 'yes', "nativesdk-glslang", "", d)}"

MACHINEOVERRIDES =. "amd:amdx86:amdgpu:"

# Metadata used by CodeBench for the ADE
ADE_CB_CPU = "general.cpu.zen"
```
