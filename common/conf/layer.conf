## common/conf/layer.conf
```bitbake
BBPATH .= ":${LAYERDIR}"
BBFILES += "${LAYERDIR}/recipes*/*/*.bb \
            ${LAYERDIR}/recipes*/*/*.bbappend"

# Let us add layer-specific bbappends which are only applied when that
# layer is included in our configuration
BBFILES += "${@' '.join('${LAYERDIR}/%s/recipes*/*/*.bbappend' % layer \
               for layer in BBFILE_COLLECTIONS.split())}"

BBFILE_COLLECTIONS += "amd"
BBFILE_PRIORITY_amd = "13"
BBFILE_PATTERN_amd = "^${LAYERDIR}/"

LICENSE_PATH += "${LAYERDIR}/licenses"
```

## common/conf/machine/include/amd-common-configurations.inc
```bitbake
POKY_DEFAULT_DISTRO_FEATURES_remove = "wayland"

PREFERRED_PROVIDER_jpeg ?= "jpeg"
PREFERRED_PROVIDER_jpeg-native ?= "jpeg-native"
PREFERRED_PROVIDER_llvm ?= "llvm3.9.1"
PREFERRED_VERSION_linux-yocto ?= "4.4%"
PREFERRED_VERSION_mesa ?= "12.0.3+git%"
PREFERRED_VERSION_gstreamer1.0-omx ?= "git+git%"
PREFERRED_VERSION_libav ?= "9.18"
PREFERRED_VERSION_grub ?= "2.00+AUTOINC+%"
PREFERRED_VERSION_grub-efi ?= "2.00+AUTOINC+%"

MULTILIBS ?= ""
require conf/multilib.conf

MACHINE_FEATURES += "wifi efi pcbios alsa"

# QEMU does not support some of the enhanced instructions available
# on the AMD chips which causes some build time failures.
MACHINE_FEATURES_remove = "qemu-usermode"

MACHINE_EXTRA_RRECOMMENDS += "kernel-modules alsa-utils"
MACHINE_EXTRA_RRECOMMENDS += "vdpauinfo util-linux-blkid"
MACHINE_EXTRA_RRECOMMENDS += "rtc-test watchdog-test spi-test smbus-test gpio-test"
MACHINE_EXTRA_RRECOMMENDS += "amd-wdt amd-spi"
MACHINE_EXTRA_RRECOMMENDS += "${@bb.utils.contains_any("DISTRO", "mel mel-lite", "firmware-wireless", "", d)}"

RELEASE_IMAGE ?= "core-image-sato"

# Add serial consoles to kernel commandline, these should occur before the tty0
KERNEL_SERIAL_CONSOLE ??= ""
APPEND += "${KERNEL_SERIAL_CONSOLE}"

# Make sure the kernel messages go to the VGA console
APPEND += "console=tty0"

# Set a generic video mode, use vga=xxx for syslinux and
# gfxpayload=wxh for grub2
SYSLINUX_KERNEL_ARGS += "vga=803"
GRUB_OPTS_append = ";set gfxpayload=1024x768"

# We use ext4 rootfs normally so give it priority rather than trying other FS first
APPEND += "rootfstype=ext4,ext3,ext2"

APPEND_ADDITIONAL ??= ""
APPEND += "${APPEND_ADDITIONAL}"

EXTRA_OECONF_append_pn-matchbox-panel-2 = " --with-battery=acpi"

# Once we switch to using the xserver-nodm-init version
# from poky, following lines should be dropped
# Currently there's a debian packaging issue with it
VIRTUAL-RUNTIME_xserver_common_pn-packagegroup-core-x11 = "xserver-common"
PREFERRED_VERSION_xserver-nodm-init ?= "2.0"

SPLASH ?= "psplash"

IMAGE_FSTYPES += "hddimg iso"
```

## common/conf/machine/include/amd-common.inc
```bitbake
IMAGE_INSTALL_append += " \
    bc \
"

GST_PACKAGES = " \
    ${@bb.utils.contains('DISTRO_FEATURES', 'x11',' \
    gstreamer1.0-meta-x11-base \
    gstreamer1.0-meta-audio \
    gstreamer1.0-meta-debug \
    gstreamer1.0-meta-video \
    gstreamer1.0-omx \
    gstreamer1.0-vaapi', '', d)}"

IMAGE_INSTALL_append_mel += " ${@bb.utils.contains("DISTRO", "mel", "${GST_PACKAGES}", "", d)}"
```

## common/conf/machine/include/amd-features.inc
```bitbake
# This file defines AMD Features that can be added as EXTRA_IMAGE_FEATURES to
# different machines based on what is supported on a machine. This gives a broad
# flexibility and control over packages being installed on a machine for any image
# without needing to create bbappends for all the images that are to be supported.
#
# > Each feature can contain packages and packagegroups as its components.
# > Feature components can be dependent on DISTRO, IMAGE_FEATURE, or any variable
#   in general. e.g.: Components of "amd-feature-graphics" may be dependent on
#   "x11-base" as an IMAGE_FEATURE. Some packages may only be included for a
#   specific DISTRO. Some packages may only be installed if user allows them in
#   local.conf etc.
# > Each machine must add the required features to EXTRA_IMAGE_FEATURES in its
#   own machine config file.
# > All required features must be added to a machine regardless of the image
#   being built, but make sure that feature components are included based on
#   dependency conditions. e.g. say "amd-feature-graphics" was added to a machine
#   that supported graphics, but components of this feature must not be installed
#   on an image that is only console based such as "core-image-base", therefore
#   such components must depend on an IMAGE_FEATURE that is based on graphics
#   such as "x11-base".
# > Each machine can also override feature components in its own machine config 
#   when adding the feature to EXTRA_IMAGE_FEATURES. e.g.: A feature may be added
#   to a specific machine with minimal (or extended) packages based on requirement.
#
# Features are classified as:
#
# * amd-common-pkgs		: Common packages to be added to all machines
# * amd-feature-multimedia	: Multimedia packages (it does not depend on graphics because a machine may not have a GUI but could play videos and sounds from console)
# * amd-feature-graphics	: Graphics packages
# * amd-feature-networking	: Networking packages
# * amd-feature-debug-profile	: Debugging and Profiling tools
# * <add more features here>	: <feature summary>

# Add common feartures to be supported for all machines here
EXTRA_IMAGE_FEATURES += "amd-common-pkgs amd-feature-multimedia"

GSTREAMER_PKGS ?= " \
    ${@bb.utils.contains("IMAGE_FEATURES", "x11-base", "gstreamer1.0-meta-x11-base", "", d)} \
    ${@bb.utils.contains("IMAGE_FEATURES", "tools-audio", "gstreamer1.0-meta-audio", "", d)} \
    gstreamer1.0-meta-debug \
    gstreamer1.0-meta-video \
    gstreamer1.0-omx \
    gstreamer1.0-vaapi \
"
VULKAN_PKGS ?= ""
CODEXL_PKGS ?= ""
DPDK_PKGS ?= ""

# Additional packages can be added to the following feature specific
# variables from each machine's config file
AMD_FEATURE_MULTIMEDIA_PKGS ?= ""
AMD_FEATURE_GRAPHICS_PKGS ?= ""
AMD_FEATURE_NETWORKING_PKGS ?= ""
AMD_FEATURE_DEBUG_PROFILE_PKGS ?= ""

FEATURE_PACKAGES_amd-common-pkgs = "\
    bc \
"

FEATURE_PACKAGES_amd-feature-multimedia = "\
    ${@bb.utils.contains("DISTRO", "mel", "${GSTREAMER_PKGS}", "", d)} \
    ${AMD_FEATURE_MULTIMEDIA_PKGS} \
"

FEATURE_PACKAGES_amd-feature-graphics = "\
    ${@bb.utils.contains("INCLUDE_VULKAN", "yes", "${VULKAN_PKGS}", "", d)} \
    ${AMD_FEATURE_GRAPHICS_PKGS} \
"
FEATURE_PACKAGES_amd-feature-graphics_append_amdgpu = " mesa-demos"
FEATURE_PACKAGES_amd-feature-graphics_append_radeon = " mesa-demos"

FEATURE_PACKAGES_amd-feature-networking = "\
    ${@bb.utils.contains("DISTRO", "mel", "${DPDK_PKGS} strongswan", "", d)} \
    ${AMD_FEATURE_NETWORKING_PKGS} \
"

FEATURE_PACKAGES_amd-feature-debug-profile = "\
    ${@bb.utils.contains("INCLUDE_CODEXL", "yes", "${CODEXL_PKGS}", "", d)} \
    ${AMD_FEATURE_DEBUG_PROFILE_PKGS} \
"
```

## common/conf/machine/include/amd-multimedia.inc
```bitbake
GST_PACKAGES = " \
    gstreamer1.0-meta-x11-base \
    gstreamer1.0-meta-audio \
    gstreamer1.0-meta-debug \
    gstreamer1.0-meta-video \
    gstreamer1.0-omx \
    gstreamer-vaapi-1.0 \
"
IMAGE_INSTALL_append_mel += " ${@bb.utils.contains("DISTRO", "mel", "${GST_PACKAGES}", "", d)}"
```

## meta-amdfalconx86/conf/layer.conf
```bitbake
# We have a conf and classes directory, add to BBPATH
BBPATH .= ":${LAYERDIR}"

# We have a recipes-* directories, add to BBFILES
BBFILES += "${LAYERDIR}/recipes-*/*/*.bb \
	${LAYERDIR}/recipes-*/*/*.bbappend"

BBFILE_COLLECTIONS += "amdfalconx86"
BBFILE_PATTERN_amdfalconx86 = "^${LAYERDIR}/"
BBFILE_PRIORITY_amdfalconx86 = "14"

LAYERDEPENDS_amdfalconx86 = "amd openembedded-layer"
```

## meta-amdfalconx86/conf/machine/amdfalconx86.conf
```bitbake
#@TYPE: Machine
#@NAME: amdfalconx86

#@DESCRIPTION: Machine configuration for amdfalconx86 systems

PREFERRED_PROVIDER_virtual/kernel ?= "${@bb.utils.contains('RT_KERNEL_AMD', 'yes', "linux-yocto-rt", "linux-yocto", d)}"
PREFERRED_VERSION_linux-yocto-rt ?= "4.4%"
PREFERRED_VERSION_libdrm ?= "2.4.66"

require conf/machine/include/tune-amdfalconx86.inc

include conf/machine/include/amd-common-configurations.inc
include conf/machine/include/amd-customer-configurations.inc

# Disable GPU if RT kernel is in use
XSERVER_X86_AMDGPU = "xf86-video-amd \
           ${@bb.utils.contains('DISTRO_FEATURES', 'opengl', 'mesa-driver-radeonsi', '', d)} \
           "
XSERVER_X86_NOGPU = "${@bb.utils.contains('DISTRO_FEATURES', 'opengl', 'mesa-driver-swrast', '', d)}"
XSERVER_X86_GPU = "${@bb.utils.contains('RT_KERNEL_AMD', 'yes', "${XSERVER_X86_NOGPU}", "${XSERVER_X86_AMDGPU}", d)}"

XSERVER ?= "${XSERVER_X86_BASE} \
            ${XSERVER_X86_EXT} \
            ${XSERVER_X86_FBDEV} \
            ${XSERVER_X86_MODESETTING} \
            ${XSERVER_X86_GPU} \
           "

MACHINE_EXTRA_RRECOMMENDS += "${@bb.utils.contains('RT_KERNEL_AMD', 'yes', "", "amdgpu-firmware amd-acp-rt286-load", d)}"

KERNEL_MODULE_AUTOLOAD += "${@bb.utils.contains('RT_KERNEL_AMD', 'yes', "", "snd-soc-acp-pcm snd-soc-acp-rt286-mach", d)}"

# Setup a getty on all serial ports
# ttyS4/ttyS5 are only needed for Bettongs where console doesn't
# work on ttyS0/ttyS1 so we hope to at least get a getty running
SERIAL_CONSOLES ?= "115200;ttyS0 115200;ttyUSB0 115200;ttyS4 115200;ttyS5"

# Enable the kernel console on ttyS0/COM0
KERNEL_SERIAL_CONSOLE ?= "console=ttyS0,115200n8"

# Enable powerplay
APPEND += "amdgpu.powerplay=1"

TOOLCHAIN_HOST_TASK_append_mel = " ${@bb.utils.contains('INCLUDE_VULKAN', 'yes', "nativesdk-glslang", "", d)}"

MACHINEOVERRIDES =. "amd:amdx86:amdgpu:"

# Metadata used by CodeBench for the ADE
ADE_CB_CPU = "general.cpu.excavator"
```

## meta-amdfalconx86/conf/machine/include/tune-amdfalconx86.inc
```bitbake
DEFAULTTUNE ?= "dbfp4"

require conf/machine/include/x86/arch-x86.inc
require conf/machine/include/x86-base.inc


# AMD DB-FP4 64bit (MerlinFalcon)
TUNEVALID[dbfp4] = "Enable AMD DB-FP4 (64 bit) specific processor optimizations"
TUNECONFLICTS[dbfp4] = "m32 mx32"
TUNE_ARCH .= "${@bb.utils.contains("TUNE_FEATURES", "dbfp4", "${X86ARCH64}", "" ,d)}"
TUNE_CCARGS .= "${@bb.utils.contains("TUNE_FEATURES", "dbfp4", " -march=bdver4", "", d)}"

# Extra tune selections
AVAILTUNES += "dbfp4"
TUNE_FEATURES_tune-dbfp4 = "dbfp4"
BASE_LIB_tune-dbfp4 = "lib64"
TUNE_PKGARCH_tune-dbfp4 = "dbfp4"
PACKAGE_EXTRA_ARCHS_tune-dbfp4 = "${TUNE_PKGARCH_tune-dbfp4}"
```

## meta-baldeagle/conf/machine/baldeagle.conf
```bitbake
#@TYPE: Machine
#@NAME: baldeagle

#@DESCRIPTION: Machine configuration for baldeagle systems

PREFERRED_PROVIDER_virtual/kernel ?= "linux-yocto"

require conf/machine/include/tune-baldeagle.inc

include conf/machine/include/amd-common-configurations.inc

# Disable GPU if RT kernel is in use
XSERVER_X86_RADEON = "xf86-video-amd \
           ${@bb.utils.contains('DISTRO_FEATURES', 'opengl', 'mesa-driver-radeon', '', d)} \
           "
XSERVER_X86_NOGPU = "${@bb.utils.contains('DISTRO_FEATURES', 'opengl', 'mesa-driver-swrast', '', d)}"
XSERVER_X86_GPU = "${@bb.utils.contains('RT_KERNEL_AMD', 'yes', "${XSERVER_X86_NOGPU}", "${XSERVER_X86_RADEON}", d)}"

XSERVER ?= "${XSERVER_X86_BASE} \
            ${XSERVER_X86_EXT} \
            ${XSERVER_X86_FBDEV} \
            ${XSERVER_X86_MODESETTING} \
            ${XSERVER_X86_GPU} \
           "

MACHINE_EXTRA_RRECOMMENDS += "radeon-firmware amd-gpio"

# Setup a gettys on all serial ports
SERIAL_CONSOLES = "115200;ttyUSB0 115200;ttyS1 115200;ttyS0"

# Enable the kernel console on ttyS0/COM0
KERNEL_SERIAL_CONSOLE = "console=ttyS0,115200n8"

APPEND += "radeon.dpm=1"

MACHINEOVERRIDES =. "amd:amdx86:radeon:"
```

## meta-baldeagle/conf/machine/include/tune-baldeagle.inc
```bitbake
DEFAULTTUNE ?= "dbfp3"

require conf/machine/include/x86/arch-x86.inc
require conf/machine/include/x86-base.inc


# AMD DB-FP3 64bit (BaldEagle)
TUNEVALID[dbfp3] = "Enable AMD DB-FP3 (64 bit) specific processor optimizations"
TUNECONFLICTS[dbfp3] = "m32 mx32"
TUNE_ARCH .= "${@bb.utils.contains("TUNE_FEATURES", "dbfp3", "${X86ARCH64}", "" ,d)}"
TUNE_CCARGS .= "${@bb.utils.contains("TUNE_FEATURES", "dbfp3", " -march=bdver3", "", d)}"

# Extra tune selections
AVAILTUNES += "dbfp3"
TUNE_FEATURES_tune-dbfp3 = "dbfp3"
BASE_LIB_tune-dbfp3 = "lib64"
TUNE_PKGARCH_tune-dbfp3 = "dbfp3"
PACKAGE_EXTRA_ARCHS_tune-dbfp3 = "${TUNE_PKGARCH_tune-dbfp3}"
```

## meta-snowyowl/conf/layer.conf
```bitbake
# We have a conf and classes directory, add to BBPATH
BBPATH .= ":${LAYERDIR}"

# We have a recipes-* directories, add to BBFILES
BBFILES += "${LAYERDIR}/recipes-*/*/*.bb \
	${LAYERDIR}/recipes-*/*/*.bbappend"

BBFILE_COLLECTIONS += "snowyowl"
BBFILE_PATTERN_snowyowl = "^${LAYERDIR}/"
BBFILE_PRIORITY_snowyowl = "14"
LAYERSERIES_COMPAT_snowyowl = "sumo"

LAYERDEPENDS_snowyowl = "amd"
```

## meta-snowyowl/conf/machine/include/tune-snowyowl.inc
```bitbake
DEFAULTTUNE ?= "znver1"

require conf/machine/include/x86/arch-x86.inc
require conf/machine/include/x86-base.inc


# AMD ZNVER1 64bit (Snowy Owl)
TUNEVALID[znver1] = "Enable AMD DB-FP4 (64 bit) specific processor optimizations"
TUNECONFLICTS[znver1] = "m32 mx32"
TUNE_ARCH .= "${@bb.utils.contains("TUNE_FEATURES", "znver1", "${X86ARCH64}", "" ,d)}"
TUNE_CCARGS .= "${@bb.utils.contains("TUNE_FEATURES", "znver1", " -march=znver1", "", d)}"

# Extra tune selections
AVAILTUNES += "znver1"
TUNE_FEATURES_tune-znver1 = "znver1"
BASE_LIB_tune-znver1 = "lib64"
TUNE_PKGARCH_tune-znver1 = "znver1"
PACKAGE_EXTRA_ARCHS_tune-znver1 = "${TUNE_PKGARCH_tune-znver1}"
```

## meta-snowyowl/conf/machine/snowyowl.conf
```bitbake
#@TYPE: Machine
#@NAME: snowyowl

#@DESCRIPTION: Machine configuration for snowyowl systems

PREFERRED_PROVIDER_virtual/kernel ?= "${@bb.utils.contains('RT_KERNEL_AMD', 'yes', "linux-yocto-rt", "linux-yocto", d)}"
PREFERRED_VERSION_linux-yocto ?= "4.9%"
PREFERRED_VERSION_linux-yocto-rt ?= "4.9%"

require conf/machine/include/tune-snowyowl.inc

include conf/machine/include/amd-common-configurations.inc
include conf/machine/include/amd-customer-configurations.inc

MACHINE_FEATURES_remove = "alsa"
MACHINE_EXTRA_RRECOMMENDS_remove = "vdpauinfo rtc-test alsa-utils"

XSERVER ?= "${XSERVER_X86_BASE} \
            ${XSERVER_X86_EXT} \
            ${XSERVER_X86_FBDEV} \
           "

# Setup a getty on all serial ports
SERIAL_CONSOLES ?= "115200;ttyS4 115200;ttyS5"

# Enable the kernel console on ttyS4/COM0
KERNEL_SERIAL_CONSOLE ?= "console=ttyS4,115200n8"

# Disable the graphical console, no graphics support for now
# this allows the serial console to be used for installation
APPEND_remove="console=tty0"

# Drop features we do not need
DISTRO_FEATURES_remove="opengl x11 alsa pulseaudio"

MACHINEOVERRIDES =. "amd:amdx86:"

# Metadata used by CodeBench for the ADE
ADE_CB_CPU = "general.cpu.zen"
```

## meta-steppeeagle/conf/layer.conf
```bitbake
# We have a conf and classes directory, add to BBPATH
BBPATH .= ":${LAYERDIR}"

# We have a recipes-* directories, add to BBFILES
BBFILES += "${LAYERDIR}/recipes-*/*/*.bb \
	${LAYERDIR}/recipes-*/*/*.bbappend"

BBFILE_COLLECTIONS += "steppeeagle"
BBFILE_PATTERN_steppeeagle = "^${LAYERDIR}/"
BBFILE_PRIORITY_steppeeagle = "14"

LAYERDEPENDS_steppeeagle = "amd openembedded-layer"
```
